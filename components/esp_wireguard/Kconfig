## components/esp_wireguard/Kconfig
```kconfig
menu "WireGuard"

choice WIREGUARD_ESP_ADAPTER_SELECTION
    prompt "TCP/IP adapter to use"
    default WIREGUARD_ESP_NETIF
    config WIREGUARD_ESP_TCPIP_ADAPTER
        bool "TCP/IP Adapter (pre esp-idf v4.1, ESP8266 RTOS SDK)"
    config WIREGUARD_ESP_NETIF
        bool "ESP-NETIF"
endchoice

config WIREGUARD_MAX_PEERS
    int "Max number of peers"
    default 1

config WIREGUARD_MAX_SRC_IPS
	int "Max number of SRC IP addresses"
	default 2

config MAX_INITIATIONS_PER_SECOND
    int "Per device limit on accepting (valid) initiation requests"
    default 2
    help
        Per device limit on accepting (valid) initiation requests - per peer.
choice WIREGUARD_x25519_IMPLEMENTATION
    prompt "x25519 implementation to use"
    default WIREGUARD_x25519_IMPLEMENTATION_DEFAULT
    config WIREGUARD_x25519_IMPLEMENTATION_DEFAULT
        bool "Default (originally from wireguard-lwip)"
    config WIREGUARD_x25519_IMPLEMENTATION_NACL
        bool "NaCL"
endchoice
endmenu
```

## components/esp_wireguard/examples/demo/main/Kconfig.projbuild
```kconfig
menu "Example Configuration"

    config ESP_WIFI_SSID
        string "WiFi SSID"
        default "myssid"
        help
            SSID (network name) for the example to connect to.

    config ESP_WIFI_PASSWORD
        string "WiFi Password"
        default "mypassword"
        help
            WiFi password (WPA or WPA2) for the example to use.

    config ESP_MAXIMUM_RETRY
        int "Maximum retry"
        default 5
        help
            Set the Maximum retry to avoid station reconnecting to the AP
            unlimited when the AP is really inexistent.

    config WG_PRIVATE_KEY
        string "Wireguard Private Key"
        default "IsvT72MAXzA8EtV0FSD1QT59B4x0oe6Uea5rd/dDzhE="
        help
            Private key of the WireGuard device.

    config WG_LOCAL_IP_ADDRESS
        string "Wireguard local IP address"
        default "192.168.4.58"
        help
            Local IP address of the WireGuard device.

    config WG_LOCAL_IP_NETMASK
        string "Wireguard local netmask"
        default "255.255.255.0"
        help
            Netmask of the local network the WireGuard device belongs to.

    config WG_LOCAL_PORT
        int "Wireguard local port"
        default 11010
        help
            Local port to listen.

    config WG_PEER_PUBLIC_KEY
        string "Wireguard remote peer public key"
        default "FjrsQ/HD1Q8fUlFILIasDlOuajMeZov4NGqMJpkswiw="
        help
            Public key of the remote peer.

    config WG_PRESHARED_KEY
        string "Wireguard pre-shared symmetric key"
        default "0/2H97Sd5EJ9LAAAYUglVjPYv7ihNIm/ziuv6BtSI50="
        help
            Public key of the remote peer.

    config WG_PEER_ADDRESS
        string "Wireguard remote peer address"
        default "demo.wireguard.com"
        help
            Address of the remote peer.

    config WG_PEER_PORT
        int "Wireguard remote peer port"
        default 12912
        help
            Port number of the remote peer.

    config WG_PERSISTENT_KEEP_ALIVE
        int "Interval to send an authenticated empty packet"
        default 0
        help
            A seconds interval, between 1 and 65535 inclusive, of how often to
            send an authenticated empty packet to the peer for the purpose of
            keeping a stateful firewall or NAT mapping valid persistently
    config EXAMPLE_PING_ADDRESS
        string "Target IP address or name"
        default "192.168.4.254"
        help
            Target IP address to send ICMP echo requests.
endmenu
```
